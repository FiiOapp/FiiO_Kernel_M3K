## arch/mips/xburst/soc-4775/chip-4775/Kconfig
```kconfig
choice
	prompt "Board type"
	depends on SOC_4775
	default PRODUCT_MENSA

config PRODUCT_MENSA
    bool "product mensa"

endchoice

config PRODUCT_NAME
string
	default "mensa" if PRODUCT_MENSA


#if PRODUCT_MENSA
source "arch/mips/xburst/soc-4775/chip-4775/mensa/Kconfig"
#endif
```

## arch/mips/xburst/soc-4775/chip-4775/mensa/Kconfig
```kconfig
choice
prompt "BOARD version"
depends on PRODUCT_MENSA
default BOARD_MENSA_V12

config BOARD_MANSA_V12
bool "board mensa v12"
depends on PRODUCT_MENSA

endchoice

config BOARD_NAME
string
default "mensa_v12" if BOARD_MANSA_V12
```

## arch/mips/xburst/soc-4780/Kconfig
```kconfig
choice
	prompt "Chip type"
	depends on SOC_4780
	default CHIP_4780

config CHIP_4780
       bool "chip-4780"
       select TRACEPOINTS
       select SYS_SUPPORTS_HIGHMEM
       select GENERIC_CLOCKEVENTS_BROADCAST

endchoice

config CHIP_NAME
	string
	default "chip-4780" if CHIP_4780
	default "chip-4775" if CHIP_4775
	default "chip-m200" if CHIP_M200
	default "chip-x1000" if CHIP_X1000

source "arch/mips/xburst/soc-4780/chip-4780/Kconfig"
```

## arch/mips/xburst/soc-4780/chip-4780/Kconfig
```kconfig
choice
	prompt "Board type"
	depends on CHIP_4780
	default CI20

config CI20
       bool "ci20"

endchoice

config PRODUCT_NAME
	string
	default "ci20" if CI20

source "arch/mips/xburst/soc-4780/chip-4780/ci20/Kconfig"
```

## arch/mips/xburst/soc-4780/chip-4780/ci20/Kconfig
```kconfig
choice
	prompt "BOARD type"
	depends on CI20
	default CI20_V10

config CI20_V10
       bool "ci20 v10"
       depends on CI20

endchoice

config BOARD_NAME
	string
	default "ci20_v10" if CI20_V10
```

## arch/mips/xburst/soc-m200/Kconfig
```kconfig
choice
	prompt "Chip type"
	depends on SOC_M200
	default CHIP_M200

config CHIP_M200
       bool "chip-m200"
       select TRACEPOINTS
       select SYS_SUPPORTS_HIGHMEM
       select GENERIC_CLOCKEVENTS_BROADCAST

config CHIP_M200S
       bool "chip-m200s"
       select TRACEPOINTS
       select SYS_SUPPORTS_HIGHMEM
       select GENERIC_CLOCKEVENTS_BROADCAST

endchoice

if CHIP_M200
source "arch/mips/xburst/soc-m200/chip-m200/Kconfig"
endif
if CHIP_M200S
source "arch/mips/xburst/soc-m200/chip-m200s/Kconfig"
endif
```

## arch/mips/xburst/soc-m200/chip-m200s/Kconfig
```kconfig
choice
	prompt "Board type"
	depends on CHIP_M200S
	default BOARD_NEWTON2P

config BOARD_NEWTON2P
       bool "NEWTON2 PLUS"

endchoice

config PRODUCT_NAME
	string
	default "newton2p" if BOARD_NEWTON2P

if BOARD_NEWTON2P
source "arch/mips/xburst/soc-m200/chip-m200s/newton2p/Kconfig"
endif
```

## arch/mips/xburst/soc-m200/chip-m200s/newton2p/Kconfig
```kconfig
choice
	prompt "Core Board Version"
	depends on BOARD_NEWTON2P
	default BOARD_NEWTON2P_V10

config BOARD_NEWTON2P_V10
       bool "NEWTON2_PLUS_V10"

endchoice

config BOARD_NAME
	string
	default "newton2p_v10" if BOARD_NEWTON2P_V10
```

## arch/mips/xburst/soc-x1000/chip-x1000/pansy/Kconfig
```kconfig
choice
prompt "BOARD version"
depends on PRODUCT_X1000_PANSY
default BOARD_X1000_PANSY_V13

config BOARD_X1000_PANSY_V10
bool "board x1000 pansy v10"
depends on PRODUCT_X1000_PANSY

config BOARD_X1000_PANSY_V13
bool "board x1000 pansy v13"
depends on PRODUCT_X1000_PANSY

endchoice

config BOARD_NAME
string
default "pansy_v10" if BOARD_X1000_PANSY_V10

config BOARD_NAME
string
default "pansy_v13" if BOARD_X1000_PANSY_V13
```

## arch/mips/xburst/soc-x1000/chip-x1500/Kconfig
```kconfig
choice
	prompt "Board type"
	depends on CHIP_X1500
	default PRODUCT_X1500_YAK

config  PRODUCT_X1500_YAK
    bool "product x1500 yak"

endchoice

if PRODUCT_X1500_YAK
config PRODUCT_NAME
string
default "yak"
source "arch/mips/xburst/soc-x1000/chip-x1500/yak/Kconfig"
endif
```

## arch/mips/xburst/soc-x1000/chip-x1500/yak/Kconfig
```kconfig
choice
prompt "Board Version"
depends on PRODUCT_X1500_YAK
default BOARD_X1500_YAK_V10

config BOARD_X1500_YAK_V10
bool "board x1500 yak v10"
depends on PRODUCT_X1500_YAK

endchoice

config BOARD_NAME
string
default "yak_v10" if BOARD_X1500_YAK_V10
```

## drivers/gpu/drm/jzdrm/Kconfig
```kconfig
config DRM_JZDRM
	tristate "DRM Support for Ingenic LCDC Display Controller"
	depends on DRM
	select DRM_KMS_HELPER
	select DRM_KMS_FB_HELPER
	select DRM_KMS_CMA_HELPER
	select DRM_GEM_CMA_HELPER
	select VIDEOMODE_HELPERS
	select BACKLIGHT_CLASS_DEVICE
	select BACKLIGHT_LCD_SUPPORT
	help
	  Choose this option if you have an Ingenic SoC with LCDC display
	  controller, for example the CI20 board

config JZ_MIPI_DSI_MODE1
	bool "mipi dsi interface control from crtc"
	depends on JZ_MIPI_DSI

config JZ_MIPI_DSI_MODE2
	bool "mipi dsi interface control from encoder and connector"
	depends on JZ_MIPI_DSI
```

## drivers/misc/jz_dmmu/Kconfig
```kconfig
menuconfig JZ_DMMU
	bool "JZ DMMU Driver"
	depends on SOC_4775
	default y
	help
	  Support for Ingenic dmmu operations.

choice
	prompt "Dmmu Version Choice "
	depends on JZ_DMMU
	default JZ_DMMU_V10

config JZ_DMMU_V10
	bool "Dmmu V10 Driver"
	help
	  Support for Ingenic dmmu v10 operations.

config JZ_DMMU_V12
	bool "Dmmu V12 Driver"
	help
	  Support for Ingenic dmmu v12 operations.

endchoice
```

## drivers/net/wireless/bcmdhd_43362/Kconfig
```kconfig
config BCMDHD_43362
	tristate "Broadcom 4329/30 wireless cards support"
	depends on MMC
	---help---
	  This module adds support for wireless adapters based on
	  Broadcom 4329/30 chipset.

config BCMDHD_FW_PATH
	depends on BCMDHD_43362
	string "Firmware path"
	default "/system/etc/firmware/fw_bcmdhd.bin"
	---help---
	  Path to the firmware file.

config BCMDHD_NVRAM_PATH
	depends on BCMDHD_43362
	string "NVRAM path"
	default "/system/etc/firmware/nvram.txt"
	---help---
	  Path to the calibration file.

config BCMDHD_WEXT
	bool "Enable WEXT support"
	depends on BCMDHD_43362 && CFG80211 = n
	select WIRELESS_EXT
	select WEXT_PRIV
	help
	  Enables WEXT support

choice
	depends on BCMDHD_43362
	prompt "Interrupt type"
	default BCMDHD_OOB
	---help---
	  Interrupt type
config BCMDHD_OOB
	depends on BCMDHD_43362
	bool "Out-of-Band Interrupt"
	---help---
	  Interrupt from WL_HOST_WAKE.
config BCMDHD_SDIO_IRQ
	depends on  BCMDHD_43362
	bool "In-Band Interrupt"
	---help---
	  Interrupt from SDIO DAT[1]
endchoice
```

## drivers/spi/rfid/Kconfig
```kconfig
menuconfig SPI_RFID
bool "Contactless cards IC support"

if SPI_RFID

config SKY1311S
	tristate "sky1311s contactless reader IC driver support"
	default n
	---help---
	  If you say yes here you get support for the skyrelay sky1311s
	  contactless reader IC driver. You can also compile this driver
	  as a module, choose M here: the module will be called sky1311s.
	  If unsure, say N here.

config SKY1311S_DRV_HOLD_CS
	bool "sky1311s driver hold cs pin"
	default n
    depends on SKY1311S
	---help---
	  Select sky1311s cs pin set by its driver when in transit，or
	  cs pin will set by jz_spi driver.

config SKY1311S_SPI_SPEED
	int "spi speed in HZ"
	range 1000000 10000000
	default 5000000
    depends on SKY1311S
	help
	  Set skyrelay sky1311s contactless reader IC spi speed.
	  Examples:
	             3000000 => 3 MHZ
                 5000000 => 5 MHZ

config SKY1311T
	tristate "sky1311t contactless reader IC driver support"
	default n
	---help---
	  If you say yes here you get support for the skyrelay sky1311t
	  contactless reader IC driver. You can also compile this driver
	  as a module, choose M here: the module will be called sky1311t.
	  If unsure, say N here.

config SKY1311T_DRV_HOLD_CS
	bool "sky1311t driver hold cs pin"
	default n
    depends on SKY1311T
	---help---
	  Select sky1311t cs pin set by its driver when in transit，or
	  cs pin will set by jz_spi driver.


config SKY1311T_SPI_SPEED
	int "spi speed in HZ"
	range 1000000 10000000
	default 5000000
    depends on SKY1311T
	help
	  Set skyrelay sky1311t contactless reader IC spi speed.
	  Examples:
	             3000000 => 3 MHZ
                 5000000 => 5 MHZ

endif
```

## drivers/staging/linux-extras/Kconfig
```kconfig
menu "Linux extra drivers"

config LINUX_EXTRAS
	bool "Linux Extra Drivers"
	default N
	---help---
	  Enable support for various drivers needed on the Linux platform

if LINUX_EXTRAS

config LINUX_INTF_ALARM_DEV
	bool "Linux alarm driver"
	depends on RTC_CLASS && !ANDROID_INTF_ALARM_DEV
	default n
	---help---
	  Provides non-wakeup and rtc backed wakeup alarms based on rtc or
	  elapsed realtime, and a non-wakeup alarm on the monotonic clock.
	  Also exports the alarm interface to user-space.

endif # if LINUX_EXTRAS

endmenu
```

## drivers/video/jz_fb_mipi_only/Kconfig
```kconfig
# JZ LCD V1.2  configuration

menuconfig FB_MIPI_ONLY
	tristate "JZ LCDC framebuffer for MIPI_ONLY"
	depends on FB && SOC_M200
	select FB_CFB_FILLRECT
	select FB_CFB_COPYAREA
	select FB_CFB_IMAGEBLIT
	help
	  Framebuffer support for the M200s SoC.

choice
	depends on FB_MIPI_ONLY
	prompt "newtun2_plus backlight"
	default LCD_EDO_E1392AM1

config LCD_EDO_E1392AM1
	tristate "EDO 1.39 inch AMOLED mipi-dsi panel(400x4000)"
	depends on FB && JZ_MIPI_DSI
	help
	jz mipi dsi.dpi AMOLED display panel support

endchoice

config DELAY_AFTER_LCD_DISPLAY_ON
	int "delay ms after the lcd display on, when fb resume"
	depends on FB_MIPI_ONLY
	default 0

config JZ_MIPI_DSI
	bool "jz mipi dsi interface"
    depends on FB_MIPI_ONLY
	default n


config JZ_MIPI_DBI
	bool "jz mipi dbi support mipi slcd"
    depends on JZ_MIPI_DSI
	default n

config DSI_DPI_DEBUG
	bool "only for tft.dpi interface debug and color test pattern"
	depends on JZ_MIPI_DSI
	default n

config LINUX_DESKTOP_SUPPORT
	bool "linux desktop support"
    depends on FB_MIPI_ONLY
	default n
	help
		this config is for jz_fb suport the buildroot or the debain desktop
```

## fs/exfat-nofuse/Kconfig
```kconfig
config EXFAT_FS
	tristate "exfat filesystem support"
	help
	   the type of exfat for TF card,if you're not sure,select it.
```
